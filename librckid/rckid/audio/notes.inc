/** from https://en.wikipedia.org/wiki/Piano_key_frequencies
 */

// name, frequency, midi number

NOTE(A0,    275,  21)
NOTE(As0,   291,  22)
NOTE(B0,    309,  23)

NOTE(C1,    309,  24)
NOTE(Cs1,   327,  25)
NOTE(D1,    346,  26)
NOTE(Ds1,   367,  27)
NOTE(E1,    389,  28)
NOTE(F1,    412,  29)
NOTE(Fs1,   437,  30)
NOTE(G1,    462,  31)
NOTE(Gs1,   490,  32)
NOTE(A1,    519,  33)
NOTE(As1,   550,  34)
NOTE(B1,    583,  35)

NOTE(C2,    654,  36)
NOTE(Cs2,   693,  37)
NOTE(D2,    734,  38)
NOTE(Ds2,   778,  39)
NOTE(E2,    824,  40)
NOTE(F2,    873,  41)
NOTE(Fs2,   925,  42)
NOTE(G2,    980,  43)
NOTE(Gs2,  1038,  44)
NOTE(A2,   1100,  45)
NOTE(As2,  1165,  46)
NOTE(B2,   1235,  47)

NOTE(C3,   1308,  48)
NOTE(Cs3,  1386,  49)
NOTE(D3,   1468,  50)
NOTE(Ds3,  1556,  51)
NOTE(E3,   1648,  52)
NOTE(F3,   1746,  53)
NOTE(Fs3,  1850,  54)
NOTE(G3,   1960,  55)
NOTE(Gs3,  2077,  56)
NOTE(A3,   2200,  57)
NOTE(As3,  2331,  58)
NOTE(B3,   2469,  59)

NOTE(C4,   2616,  60)
NOTE(Cs4,  2772,  61)
NOTE(D4,   2937,  62)
NOTE(Ds4,  3111,  63)
NOTE(E4,   3296,  64)
NOTE(F4,   3492,  65)
NOTE(Fs4,  3700,  66)
NOTE(G4,   3920,  67)
NOTE(Gs4,  4153,  68)
NOTE(A4,   4400,  69)
NOTE(As4,  4662,  70)
NOTE(B4,   4939,  71)

NOTE(C5,   5233,  72)
NOTE(Cs5,  5544,  73)
NOTE(D5,   5873,  74)
NOTE(Ds5,  6223,  75)
NOTE(E5,   6593,  76)
NOTE(F5,   6985,  77)
NOTE(Fs5,  7400,  78)
NOTE(G5,   7840,  79)
NOTE(Gs5,  8306,  80)
NOTE(A5,   8800,  81)
NOTE(As5,  9323,  82)
NOTE(B5,   9878,  83)

NOTE(C6,  10465,  84)
NOTE(Cs6, 11087,  85)
NOTE(D6,  11747,  86)
NOTE(Ds6, 12445,  87)
NOTE(E6,  13185,  88)
NOTE(F6,  13969,  89)
NOTE(Fs6, 14800,  90)
NOTE(G6,  15680,  91)
NOTE(Gs6, 16612,  92)
NOTE(A6,  17600,  93)
NOTE(As6, 18647,  94)
NOTE(B6,  19755,  95)

NOTE(C7,  20930,  96)
NOTE(Cs7, 22175,  97)
NOTE(D7,  23493,  98)
NOTE(Ds7, 24890,  99)
NOTE(E7,  26370, 100)
NOTE(F7,  27938, 101)
NOTE(Fs7, 29600, 102)
NOTE(G7,  31360, 103)
NOTE(Gs7, 33224, 104)
NOTE(A7,  35200, 105)
NOTE(As7, 37293, 106)
NOTE(B7,  39511, 107)

NOTE(C8,  41860, 108)
NOTE(Cs8, 44349, 109)
NOTE(D8,  46986, 110)
NOTE(Ds8, 49780, 111)
NOTE(E8,  52740, 112)
NOTE(F8,  55877, 113)
NOTE(Fs8, 59199, 114)
NOTE(G8,  62719, 115)

#undef NOTE

