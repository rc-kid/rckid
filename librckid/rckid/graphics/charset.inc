/** Defines the default charset to be used by the fonts created by the generate-font tool. Each character defines its index, name, and an unicode character in the font that should be used to generate it. 

    To work properly, it is necessary for the printable alphanumeric charcters to be in their correco positions according to an ASCII table. Therefore each font must specify at least 128 glyphs. 
 */

GLYPH(0x00, SolidHeart,)
GLYPH(0x01, Heart,)
GLYPH(0x02, RadioOn,)
GLYPH(0x03, RadioOff,)
GLYPH(0x04, RadioBase,)
GLYPH(0x05, Battery0,)
GLYPH(0x06, Battery25,)
GLYPH(0x07, Battery50,)
GLYPH(0x08, Battery75,)
GLYPH(0x09, Battery100,)
GLYPH(0x0a,,)
GLYPH(0x0b,,)
GLYPH(0x0c,,)
GLYPH(0x0d,,)
GLYPH(0x0e,,)
GLYPH(0x0f,,)

GLYPH(0x10,,)
GLYPH(0x11,,)
GLYPH(0x12,,)
GLYPH(0x13,,)
GLYPH(0x14,,)
GLYPH(0x15,,)
GLYPH(0x16,,)
GLYPH(0x17,,)
GLYPH(0x18,,)
GLYPH(0x19,,)
GLYPH(0x1a,,)
GLYPH(0x1b,,)
GLYPH(0x1c,,)
GLYPH(0x1d,,)
GLYPH(0x1e,,)
GLYPH(0x1f,,)

GLYPH(0x20, Space, ' ')
GLYPH(0x21, ExclamationMark,'!')
GLYPH(0x22, DoubleQuote,'"')
GLYPH(0x23, Hash,'#')
GLYPH(0x24, Dollar,'$')
GLYPH(0x25, Percent,'%')
GLYPH(0x26, And,'&')
GLYPH(0x27, SingleQuote,'\'')
GLYPH(0x28, ParOpen,'(')
GLYPH(0x29, ParCLose,')')
GLYPH(0x2a, Star,'*')
GLYPH(0x2b, Plus,'+')
GLYPH(0x2c, Comma,',')
GLYPH(0x2d, Minus,'-')
GLYPH(0x2e, Dot,'.')
GLYPH(0x2f, Slash,'/')

GLYPH(0x30, Zero,'0')
GLYPH(0x31, One,'1')
GLYPH(0x32, Two,'2')
GLYPH(0x33, Three,'3')
GLYPH(0x34, Four,'4')
GLYPH(0x35, Five,'5')
GLYPH(0x36, Six,'6')
GLYPH(0x37, Seven,'7')
GLYPH(0x38, Eight,'8')
GLYPH(0x39, Nine,'9')
GLYPH(0x3a, Colon,':')
GLYPH(0x3b, Semicolon,';')
GLYPH(0x3c, LessThan,'<')
GLYPH(0x3d, Equals,'=')
GLYPH(0x3e, GreaterThan,'>')
GLYPH(0x3f, QuestionMark,'?')

GLYPH(0x40, At, '@')
GLYPH(0x41, A, 'A')
GLYPH(0x42, B, 'B')
GLYPH(0x43, C, 'C')
GLYPH(0x44, D, 'D')
GLYPH(0x45, E, 'E')
GLYPH(0x46, F, 'F')
GLYPH(0x47, G, 'G')
GLYPH(0x48, H, 'H')
GLYPH(0x49, I, 'I')
GLYPH(0x4a, J, 'J')
GLYPH(0x4b, K, 'K')
GLYPH(0x4c, L, 'L')
GLYPH(0x4d, M, 'M')
GLYPH(0x4e, N, 'N')
GLYPH(0x4f, O, 'O')

GLYPH(0x50, P, 'P')
GLYPH(0x51, Q, 'Q')
GLYPH(0x52, R, 'R')
GLYPH(0x53, S, 'S')
GLYPH(0x54, T, 'T')
GLYPH(0x55, U, 'U')
GLYPH(0x56, V, 'V')
GLYPH(0x57, W, 'W')
GLYPH(0x58, X, 'X')
GLYPH(0x59, Y, 'Y')
GLYPH(0x5a, Z, 'Z')
GLYPH(0x5b, SquareOpen, '[')
GLYPH(0x5c, BackSlash, '\\')
GLYPH(0x5d, SqureClose, ']')
GLYPH(0x5e, Hat, '^')
GLYPH(0x5f, Underscore, '_')

GLYPH(0x60, Backtick, '`')
GLYPH(0x61, a, 'a')
GLYPH(0x62, b, 'b')
GLYPH(0x63, c, 'c')
GLYPH(0x64, d, 'd')
GLYPH(0x65, e, 'e')
GLYPH(0x66, f, 'f')
GLYPH(0x67, g, 'g')
GLYPH(0x68, h, 'h')
GLYPH(0x69, i, 'i')
GLYPH(0x6a, j, 'j')
GLYPH(0x6b, k, 'k')
GLYPH(0x6c, l, 'l')
GLYPH(0x6d, m, 'm')
GLYPH(0x6e, n, 'n')
GLYPH(0x6f, o, 'o')

GLYPH(0x70, p, 'p')
GLYPH(0x71, q, 'q')
GLYPH(0x72, r, 'r')
GLYPH(0x73, s, 's')
GLYPH(0x74, t, 't')
GLYPH(0x75, u, 'u')
GLYPH(0x76, v, 'v')
GLYPH(0x77, w, 'w')
GLYPH(0x78, x, 'x')
GLYPH(0x79, y, 'y')
GLYPH(0x7a, z, 'z')
GLYPH(0x7b, CurlyOpen, '{')
GLYPH(0x7c, Pipe, '|')
GLYPH(0x7d, CurlyClose, '}')
GLYPH(0x7e, Tilde, '~')
GLYPH(0x7f,, '')
